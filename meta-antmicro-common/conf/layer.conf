## meta-antmicro-common/conf/layer.conf
```bitbake
BBPATH .= ":${LAYERDIR}"

BBFILES += "${LAYERDIR}/recipes-*/*/*.bb \
            ${LAYERDIR}/recipes-*/*/*.bbappend \
"
BBFILE_COLLECTIONS += "meta-antmicro-common"
BBFILE_PATTERN_meta-antmicro-common := "^${LAYERDIR}/"
BBFILE_PRIORITY_meta-antmicro-common = "6"

LAYERSERIES_COMPAT_meta-antmicro-common = "kirkstone scarthgap"

LAYERDEPENDS_meta-antmicro-common = " \
    openembedded-layer \
"
```

## meta-antmicro-demo-base/conf/layer.conf
```bitbake
BBPATH .= ":${LAYERDIR}"

BBFILES += "${LAYERDIR}/recipes-*/*/*.bb \
            ${LAYERDIR}/recipes-*/*/*.bbappend \
"
BBFILE_COLLECTIONS += "meta-antmicro-demo-base"
BBFILE_PATTERN_meta-antmicro-demo-base := "^${LAYERDIR}/"
BBFILE_PRIORITY_meta-antmicro-demo-base = "6"

LAYERSERIES_COMPAT_meta-antmicro-demo-base = "dunfell"

LAYERDEPENDS_meta-antmicro-demo-base = " \
    meta-antmicro-common \
    openembedded-layer \
    xfce-layer \
"

INHERIT += "extrausers"

# Password for antmicro user is 'antmicro'
PASSWD_ANTMICRO = "\$5\$xPIDxLwbppU4Z2sL\$BSrJlwS4rFn12RUKpqY86vSqmqPIngotgeZTCukKxr9"

# Password for root user is 'root'
PASSWD_ROOT = "\$5\$6G2NfMTWbwzYhU\$DKETb7UszKv5sv9AoZFld8H955nNV8BeNZ17vZnsFzB"

EXTRA_USERS_PARAMS = " \
    useradd -p '${PASSWD_ANTMICRO}' antmicro; \
    usermod -p '${PASSWD_ROOT}' root; \
    usermod -a -G dialout antmicro; \
    usermod -a -G input antmicro; \
    usermod -a -G video antmicro; \
    usermod -a -G sudo antmicro; \
"
```

## meta-jetson-alvium/conf/layer.conf
```bitbake
BBPATH .= ":${LAYERDIR}"

BBFILES += "${LAYERDIR}/recipes-*/*/*.bb \
            ${LAYERDIR}/recipes-*/*/*.bbappend"

BBFILE_COLLECTIONS += "jetson-alvium"
BBFILE_PATTERN_jetson-alvium := "^${LAYERDIR}/"
BBFILE_PRIORITY_jetson-alvium = "6"

LAYERSERIES_COMPAT_jetson-alvium = "kirkstone"

KERNEL_DEVICETREE = "tegra194-p3668-all-p3509-0000-antmicro-baseboard.dtb"
```

## meta-jetson-orin-baseboard/conf/layer.conf
```bitbake
BBPATH .= ":${LAYERDIR}"

BBFILES += "${LAYERDIR}/recipes-*/*/*.bb \
            ${LAYERDIR}/recipes-*/*/*.bbappend"

BBFILE_COLLECTIONS += "jetson-orin-baseboard"
BBFILE_PATTERN_jetson-orin-baseboard := "^${LAYERDIR}/"
BBFILE_PRIORITY_jetson-orin-baseboard = "6"

LAYERSERIES_COMPAT_jetson-orin-baseboard = "scarthgap"

# Override the default version of nvidia-kernel-oot to use JOB compatible one.
PREFERRED_VERSION_nvidia-kernel-oot = "36.4.0-antmicro-job+git"
include conf/machine/include/${MACHINE}.inc
```

## meta-jetson/conf/layer.conf
```bitbake
BBPATH .= ":${LAYERDIR}"

BBFILES += "${LAYERDIR}/recipes-*/*/*.bb \
            ${LAYERDIR}/recipes-*/*/*.bbappend"

BBFILE_COLLECTIONS += "meta-jetson"
BBFILE_PATTERN_meta-jetson := "^${LAYERDIR}/"
BBFILE_PRIORITY_meta-jetson = "6"

LAYERDEPENDS_meta-jetson = " \
    tegra \
"

LAYERSERIES_COMPAT_meta-jetson = "kirkstone scarthgap"
```

## meta-jetson/meta-rdfm-tegra/conf/layer.conf
```bitbake
# We have a conf and classes directory, add to BBPATH
BBPATH .= ":${LAYERDIR}"
# We have recipes-* directories, add to BBFILES
BBFILES += " \
    ${LAYERDIR}/recipes-*/*/*.bb \
    ${LAYERDIR}/recipes-*/*/*.bbappend \
"

BBFILE_COLLECTIONS += "meta-rdfm-tegra"
BBFILE_PATTERN_meta-rdfm-tegra = "^${LAYERDIR}/"
BBFILE_PRIORITY_meta-rdfm-tegra = "10"
LAYERVERSION_meta-rdfm-tegra = "1"
LAYERSERIES_COMPAT_meta-rdfm-tegra = "dunfell"
LAYERDEPENDS_meta-rdfm-tegra = "tegra"
```

## meta-microros/conf/layer.conf
```bitbake
BBPATH .= ":${LAYERDIR}"

BBFILES += " \
    ${LAYERDIR}/recipes-*/*/*.bb \
    ${LAYERDIR}/recipes-*/*/*.bbappend \
"
BBFILE_COLLECTIONS += "meta-microros"
BBFILE_PATTERN_meta-microros := "^${LAYERDIR}/"
BBFILE_PRIORITY_meta-microros = "14"

LAYERDEPENDS_meta-microros = " \
    ros-common-layer \
    ros2-galactic-layer \
    ros2-layer \
"

LAYERSERIES_COMPAT_meta-microros += " \
    kirkstone \
    honister \
"
```

## meta-ml-tegra/conf/layer.conf
```bitbake
BBPATH .= ":${LAYERDIR}"

BBFILES += " \
    ${LAYERDIR}/recipes-*/*/*.bb \
    ${LAYERDIR}/recipes-*/*/*.bbappend \
"

BBFILE_COLLECTIONS += "meta-ml-tegra"
BBFILE_PATTERN_meta-ml-tegra := "^${LAYERDIR}/"
BBFILE_PRIORITY_meta-ml-tegra = "10"
LAYERSERIES_COMPAT_meta-ml-tegra = "kirkstone"

LAYERDEPENDS_meta-ml-tegra = " \
    meta-jetson \
    meta-ml \
"
```

## meta-ml/conf/layer.conf
```bitbake
BBPATH .= ":${LAYERDIR}"

BBFILES += "${LAYERDIR}/recipes-*/*/*.bb \
            ${LAYERDIR}/recipes-*/*/*.bbappend \
"
BBFILE_COLLECTIONS += "meta-ml"
BBFILE_PATTERN_meta-ml := "^${LAYERDIR}/"
BBFILE_PRIORITY_meta-ml = "6"

LAYERDEPENDS_meta-ml = " \
    core \
    meta-antmicro-common \
"

LAYERSERIES_COMPAT_meta-ml = "kirkstone"
```

## meta-rdfm-renode/conf/layer.conf
```bitbake
# We have a conf and classes directory, add to BBPATH
BBPATH .= ":${LAYERDIR}"

# We have recipes-* directories, add to BBFILES
BBFILES += "${LAYERDIR}/recipes-*/*/*.bb \
            ${LAYERDIR}/recipes-*/*/*.bbappend"

BBFILE_COLLECTIONS += "meta-rdfm-renode"
BBFILE_PATTERN_meta-rdfm-renode = "^${LAYERDIR}/"
BBFILE_PRIORITY_meta-rdfm-renode = "99"
MACHINE_FEATURES += " vfat"

LAYERDEPENDS_meta-rdfm-renode = "meta-rdfm"
LAYERSERIES_COMPAT_meta-rdfm-renode = "dunfell"

# MENDER_UBOOT_STORAGE_INTERFACE:riscv64:mender-uboot = "virtio"
# MENDER_STORAGE_DEVICE_DEFAULT:riscv64:mender-client-install = "/dev/vda"
```

## meta-rdfm-tegra/conf/layer.conf
```bitbake
# We have a conf and classes directory, add to BBPATH
BBPATH .= ":${LAYERDIR}"
# We have recipes-* directories, add to BBFILES
BBFILES += " \
    ${LAYERDIR}/recipes-*/*/*.bb \
    ${LAYERDIR}/recipes-*/*/*.bbappend \
"

BBFILE_COLLECTIONS += "meta-rdfm-tegra"
BBFILE_PATTERN_meta-rdfm-tegra = "^${LAYERDIR}/"
BBFILE_PRIORITY_meta-rdfm-tegra = "10"
LAYERVERSION_meta-rdfm-tegra = "1"
LAYERSERIES_COMPAT_meta-rdfm-tegra = "kirkstone"
LAYERDEPENDS_meta-rdfm-tegra = " \
    tegra \
    meta-rdfm \
"

INHERIT += " \
    tegra-rdfm-setup \
"

# Apply custom layer configuration overrides for machines
# Regular machine configs don't seem to propagate certain variables
# such as DATA_PART_SIZE_MB to other layers. Including the config here
# makes these variables visible to the whole build.
include conf/machine/${MACHINE}-extended.conf
```

## meta-rdfm-tegra/conf/machine/p3509-a02-p3767-0000-extended.conf
```bitbake
INHERIT += "tegra-rdfm-helpers"

# Configuration for Orin with external NVMe flash
TNSPEC_BOOTDEV ?= "nvme0n1p1"
ROOTFSPART_SIZE ?= "5368709120"
# Minimal data partition size - data partition will be extended to fit the
# remaining space on the disk.
DATASIZE ?= "1073741824"

RDFM_ROOTFS_PART_BASE = "nvme0n1p"
RDFM_BOOT_PART_NUMBER = "4"
RDFM_ROOTFS_A_PART_NUMBER = "1"
RDFM_ROOTFS_B_PART_NUMBER = "2"
RDFM_DATA_PART_NUMBER = "15"
RDFM_PARTITION_SIZE_BOOTFS = "0"
RDFM_PARTITION_SIZE_ROOTFS = "${@rdfm_tegra_default_rootfs_size(d)}"
RDFM_PARTITION_SIZE_DATAFS = "${@rdfm_tegra_default_datafs_size(d)}"
```

## meta-rdfm/conf/layer.conf
```bitbake
BBPATH .= ":${LAYERDIR}"

BBFILES += "${LAYERDIR}/recipes-*/*/*.bb \
            ${LAYERDIR}/recipes-*/*/*.bbappend"

BBFILE_COLLECTIONS += "meta-rdfm"
BBFILE_PATTERN_meta-rdfm = "^${LAYERDIR}/"
BBFILE_PRIORITY_meta-rdfm = "10"

BBFILES_DYNAMIC += "\
    meta-sifive:${LAYERDIR}/meta-support/sifive/recipes-*/*/*.bbappend \
    xilinx:${LAYERDIR}/meta-support/xilinx/recipes-*/*/*.bbappend \
"

LAYERDEPENDS_meta-rdfm = " \
    core \
"
LAYERSERIES_COMPAT_meta-rdfm = "scarthgap"

INHERIT += "rdfm-full"

WIC_CREATE_EXTRA_ARGS = "--no-fstab-update"
```

## meta-rdfm/conf/machine/freedom-u540-extended.conf
```bitbake
MENDER_BOOT_PART = "${MENDER_STORAGE_DEVICE_BASE}5"
MENDER_DATA_PART = "${MENDER_STORAGE_DEVICE_BASE}8"
MENDER_ROOTFS_PART_A = "${MENDER_STORAGE_DEVICE_BASE}6"
MENDER_ROOTFS_PART_B = "${MENDER_STORAGE_DEVICE_BASE}7"
MENDER_DATA_PART_NUMBER = "8"

MENDER_BOOT_PART_SIZE_MB = "256"
MENDER_BOOT_PART_LABEL = "BOOT"
MENDER_DEVICE_TYPES_COMPATIBLE:append = " freedom-u540"
BOOTENV_SIZE = "0x20000"

MENDER_UBOOT_ENV_STORAGE_DEVICE_OFFSET = "8388608"

MACHINE_ESSENTIAL_EXTRA_RDEPENDS:append:mender-image = " \
    kernel-image \
    kernel-devicetree \
"

IMAGE_BOOT_FILES = " \
    Image.gz \
    hifive-unleashed-a00-microsemi.dtb \
"

WKS_FILE = "unleashed-spl-opensbi-rdfm.wks"
```

## meta-rdfm/conf/machine/rdfm-xilinx-generic.conf
```bitbake
WKS_FILE = "rdfm-generic-layout.wks.in"
WKS_FILES = "rdfm-generic-layout.wks.in"

RDFM_STORAGE_DEVICE = "/dev/mmcblk0"
RDFM_ROOTFS_PART_BASE = "mmcblk0p"
RDFM_PARTITION_SIZE_ROOTFS = "1048576"
RDFM_PARTITION_SIZE_BOOTFS = "524288"

BOOTENV_SIZE = "0x80000"
RDFM_ENV_OFFSET = "0x0000"
RDFM_ENV_OFFSET_REDUND = "0x0000"
RDFM_UBOOT_ENV_STORAGE ?= "/boot/uboot-redund.env"
RDFM_BOOTLOADER = "libubootenv-bin u-boot-xlnx-env"
```

## meta-rdfm/conf/machine/renodeunmatched-extended.conf
```bitbake
RDFM_BOOT_PART_NUMBER = "5"
RDFM_ROOTFS_A_PART_NUMBER = "6"
RDFM_ROOTFS_B_PART_NUMBER = "7"
RDFM_DATA_PART_NUMBER = "8"
RDFM_ROOTFS_PART_BASE = "vda"
RDFM_STORAGE_DEVICE = "/dev/vda"
RDFM_UBOOT_STORAGE_INTERFACE = "virtio"
RDFM_BOOTLOADER = "libubootenv-bin u-boot-env"

BOOTENV_SIZE = "0x20000"
RDFM_ENV_OFFSET = "0x504400"
RDFM_ENV_OFFSET_REDUND = "0x504400"

MACHINE_ESSENTIAL_EXTRA_RDEPENDS:append = " \
    kernel-image \
    kernel-devicetree \
"

IMAGE_BOOT_FILES = " \
    Image.gz \
    hifive-unmatched-a00.dtb \
"

WKS_FILE = "unmatched-spl-opensbi-rdfm.wks.in"
INITRAMFS_IMAGE:remove = "demo-coreip-cli-initramfs"
```

## meta-rdfm/conf/machine/renodezynqmp.conf
```bitbake
require conf/machine/zcu102-zynqmp.conf

KERNEL_DEVICETREE = "xilinx/zynqmp-zcu102-rev1.1.dtb"

WKS_FILE = "rdfm-generic-layout.wks.in"
WKS_FILES = "rdfm-generic-layout.wks.in"

RDFM_ROOTFS_PART_BASE = "vda"
RDFM_BOOT_PART_NUMBER = "1"
RDFM_ROOTFS_A_PART_NUMBER = "2"
RDFM_ROOTFS_B_PART_NUMBER = "3"
RDFM_DATA_PART_NUMBER = "4"
RDFM_PARTITION_SIZE_ROOTFS = "1048576"
RDFM_PARTITION_SIZE_BOOTFS = "524288"

BOOTENV_SIZE = "0x80000"
RDFM_ENV_OFFSET = "0x0000"
RDFM_ENV_OFFSET_REDUND = "0x0000"

RDFM_STORAGE_DEVICE = "/dev/vda"
RDFM_UBOOT_ENV_STORAGE = "/boot/uboot-redund.env"
RDFM_UBOOT_STORAGE_INTERFACE = "virtio"
RDFM_BOOTLOADER = "libubootenv-bin u-boot-xlnx-env"

# Xilinx bootscript doesn't support booting from virtio, so after RDFM setup we
# set the correct rootfs device, load images from virtio and start boot
RDFM_UBOOT_POST_SETUP_COMMANDS = "\
    setenv bootargs root=$\{mender_kernel_root\} $\{bootargs\}; \
    fatload virtio 0:1 0x100000 system.dtb; \
    fatload virtio 0:1 0x10000000 Image; \
    booti 0x10000000 - 0x100000 \
"
```

## meta-rdfm/conf/machine/unmatched-extended.conf
```bitbake
RDFM_BOOT_PART_NUMBER = "5"
RDFM_ROOTFS_A_PART_NUMBER = "6"
RDFM_ROOTFS_B_PART_NUMBER = "7"
RDFM_DATA_PART_NUMBER = "8"
RDFM_ROOTFS_PART_BASE = "mmcblk0p"
RDFM_STORAGE_DEVICE = "/dev/mmcblk0"

BOOTENV_SIZE = "0x20000"
RDFM_ENV_OFFSET = "0x504400"
RDFM_ENV_OFFSET_REDUND = "0x584400"

MACHINE_ESSENTIAL_EXTRA_RDEPENDS:append = " \
    kernel-image \
    kernel-devicetree \
"

IMAGE_BOOT_FILES = " \
    Image.gz \
    hifive-unmatched-a00.dtb \
"

WKS_FILE = "unmatched-spl-opensbi-rdfm.wks.in"
INITRAMFS_IMAGE:remove = "demo-coreip-cli-initramfs"
```
