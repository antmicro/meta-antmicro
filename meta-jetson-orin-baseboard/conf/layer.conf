## meta-jetson-orin-baseboard/conf/layer.conf
```bitbake
BBPATH .= ":${LAYERDIR}"

BBFILES += "${LAYERDIR}/recipes-*/*/*.bb \
            ${LAYERDIR}/recipes-*/*/*.bbappend"

BBFILE_COLLECTIONS += "jetson-orin-baseboard"
BBFILE_PATTERN_jetson-orin-baseboard := "^${LAYERDIR}/"
BBFILE_PRIORITY_jetson-orin-baseboard = "6"

LAYERSERIES_COMPAT_jetson-orin-baseboard = "wrynose blacksail"

PREFERRED_VERSION_nvidia-kernel-oot = "39.2.1+git"
include ${LAYERDIR}/conf/machine/include/${MACHINE}.inc
```

## meta-jetson-orin-baseboard/conf/machine/include/p3768-0000-p3767-0001.inc
```bitbake
TEGRA_FLASHVAR_MB2BCT_CFG = "tegra234-mb2-bct-misc-p3767-0000-antmicro-job.dts"
KERNEL_DEVICETREE = "tegra234-p3767-0001-antmicro-job.dtb"
```
